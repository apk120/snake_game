/**
 * @cliArgs --board "/ti/boards/MSP_EXP432P401R" --product "simplelink_msp432p4_sdk@3.40.01.02"
 * @versions {"data":"2021010520","timestamp":"2021010520","tool":"1.7.0+1746","templates":null}
 */

/**
 * Import the modules used in this configuration.
 */
const Display  = scripting.addModule("/ti/display/Display");
const Display1 = Display.addInstance();
const ADC      = scripting.addModule("/ti/drivers/ADC");
const ADC1     = ADC.addInstance();
const ADC2     = ADC.addInstance();
const ADC3     = ADC.addInstance();
const RTOS     = scripting.addModule("/ti/drivers/RTOS");

/**
 * Write custom configuration values to the imported modules.
 */
Display1.$name      = "CONFIG_Display_0";
Display1.$hardware  = system.deviceData.board.components.XDS110UART;
Display1.uart.$name = "CONFIG_UART_0";

ADC1.$name              = "CONFIG_ADC_0";
ADC1.resolution         = "12 Bits";
ADC1.adc.adcPin.$assign = "boosterpack.5";

ADC2.$name              = "CONFIG_ADC_1";
ADC2.resolution         = "12 Bits";
ADC2.adc.adcPin.$assign = "boosterpack.2";

ADC3.$name              = "CONFIG_ADC_2";
ADC3.resolution         = "12 Bits";
ADC3.adc.adcPin.$assign = "boosterpack.26";

const Power                   = scripting.addModule("/ti/drivers/Power", {}, false);
Power.performanceLevel3.$name = "ti_drivers_power_PowerMSP432PerfLevels0";
Power.performanceLevel2.$name = "ti_drivers_power_PowerMSP432PerfLevels1";
Power.performanceLevel1.$name = "ti_drivers_power_PowerMSP432PerfLevels2";
Power.performanceLevel0.$name = "ti_drivers_power_PowerMSP432PerfLevels3";


/**
 * Pinmux solution for unlocked pins/peripherals. This ensures that minor changes to the automatic solver in a future
 * version of the tool will not impact the pinmux you originally saw.  These lines can be completely deleted in order to
 * re-solve from scratch.
 */
Display1.uart.uart.$suggestSolution       = "EUSCI_A0";
Display1.uart.uart.txPin.$suggestSolution = "7";
Display1.uart.uart.rxPin.$suggestSolution = "6";
ADC1.adc.$suggestSolution                 = "ADC14";
ADC2.adc.$suggestSolution                 = "ADC14";
ADC3.adc.$suggestSolution                 = "ADC14";
RTOS.timer0.resource.$suggestSolution     = "Timer_A0";
